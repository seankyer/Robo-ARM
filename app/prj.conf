## CMakeLists.txt
```
# RoboARM Project
#
# SPDX-License-Identifier: Apache-2.0

cmake_minimum_required(VERSION 3.13.1)
find_package(Zephyr REQUIRED HINTS $ENV{ZEPHYR_BASE})

project(app)

target_sources(app PRIVATE
        src/main.c
        src/threads/arm_ctrl.c
        src/threads/control.c
)

target_include_directories(app PRIVATE
        ${CMAKE_SOURCE_DIR}/src
        ${CMAKE_SOURCE_DIR}/src/threads
)
```

## Kconfig
```
# Copyright (c) 2021 Nordic Semiconductor ASA
# SPDX-License-Identifier: Apache-2.0
#
# This file is the application Kconfig entry point. All application Kconfig
# options can be defined here or included via other application Kconfig files.
# You can browse these options using the west targets menuconfig (terminal) or
# guiconfig (GUI).

menu "Zephyr"
source "Kconfig.zephyr"
endmenu

module = APP
module-str = APP
source "subsys/logging/Kconfig.template.log_config"

# Pathfinding graphing algorithm choice
choice
        prompt "Pathfinding algorithm"
        default GRAPH_BFS

config GRAPH_BFS
        bool "Breafth-First Search Algorithm:"

endchoice
```

## prj.conf
```kconfig
# SPDX-License-Identifier: Apache-2.0

# Debug configurations
CONFIG_DEBUG=y
CONFIG_NO_OPTIMIZATIONS=y
CONFIG_USE_SEGGER_RTT=n
CONFIG_CBPRINTF_FP_SUPPORT=y

# Larger stack and heap for pathfinding algorithm
CONFIG_INIT_STACKS=y
CONFIG_LOG=y
CONFIG_LOG_MODE_IMMEDIATE=y

# Drivers and utility options
CONFIG_MAP_UTILS=y
CONFIG_PWM=y
CONFIG_SERVO=y
CONFIG_MG996R=y
CONFIG_SHELL=y

# Pathfinding Kconfig
CONFIG_PATHFIND=y
CONFIG_PATHFIND_ALLOWABLE_TOLERANCE_MM=1
CONFIG_PATHFIND_REQUIRED_CLEARANCE_MM=3
CONFIG_PATHFIND_WORKSPACE_SQMM=395
CONFIG_PATHFIND_ARM_LEN_MM=81
CONFIG_PATHFIND_ARM_WIDTH_MM=36
CONFIG_PATHFIND_ARM_RANGE=180
CONFIG_PATHFIND_ARM_DEGREE_INC=1
CONFIG_PATHFIND_ARM_ORIGIN_X_MM=193
CONFIG_PATHFIND_ARM_ORIGIN_Y_MM=29
```

## src/main.c
```c
/*
 * SPDX-License-Identifier: Apache-2.0
 */

#include <stdlib.h>
#include <zephyr/kernel.h>
#include <zephyr/logging/log.h>
#include <app_version.h>
#include <zephyr/shell/shell.h>

#include <threads/control.h>

LOG_MODULE_REGISTER(main, LOG_LEVEL_INF);

/**
 * Current control job
 */
static control_job_t job;

static int arm_go(const struct shell *shell, size_t argc, char **argv)
{
	int ret;
	char *end;

	if (argc != 3) {
		shell_error(shell, "Usage: go <x> <y>");
		return -EINVAL;
	}

	int x_coord = strtol(argv[1], &end, 10);
	int y_coord = strtol(argv[2], &end, 10);

	if (x_coord < 0 || x_coord > CONFIG_PATHFIND_WORKSPACE_SQMM) {
		shell_error(shell, "X-coordinate must be within bounds of workspace");
	}

	if (y_coord < 0 || y_coord > CONFIG_PATHFIND_WORKSPACE_SQMM) {
		shell_error(shell, "Y-coordinate must be within bounds of workspace");
	}

	job.x_coord = x_coord;
	job.y_coord = y_coord;
	job.demo = false;

	ret = control_submit_job(job);
	if (ret) {
		shell_error(shell, "Failed to submit job to control!");
	}

	return 0;
}

static int demo_movement(const struct shell *shell, size_t argc, char **argv)
{
	int ret;

	shell_print(shell, "Submitting demo job to control");

	job.demo = true;

	ret = control_submit_job(job);
	if (ret) {
		shell_error(shell, "Error submitting demo task!");
	}

	return 0;
}

int main(void)
{
	LOG_INF("Starting Robo-ARM!");

	return 0;
}

SHELL_CMD_REGISTER(demo, NULL, "Plays example movement", demo_movement);
SHELL_CMD_REGISTER(go, NULL, "Sets arm to given coordinates", arm_go);
```

## src/examples.h
```c
/*
 * SPDX-License-Identifier: Apache-2.0
 */

#include <lib/pathfind/pathfinding.h>

arm_job_t example_rotate_job = {
	.num_steps = 240,
	.steps = {{30, 150}, {31, 149}, {32, 148}, {33, 147}, {34, 146}, {35, 145}, {36, 144},
		  {37, 143}, {38, 142}, {39, 141}, {40, 140}, {41, 139}, {42, 138}, {43, 137},
		  {44, 136}, {45, 135}, {46, 134}, {47, 133}, {48, 132}, {49, 131}, {50, 130},
		  {51, 129}, {52, 128}, {53, 127}, {54, 126}, {55, 125}, {56, 124}, {57, 123},
		  {58, 122}, {59, 121}, {60, 120}, {61, 119}, {62, 118}, {63, 117}, {64, 116},
		  {65, 115}, {66, 114}, {67, 113}, {68, 112}, {69, 111}, {70, 110}, {71, 109},
		  {72, 108}, {73, 107}, {74, 106}, {75, 105}, {76, 104}, {77, 103}, {78, 102},
		  {79, 101}, {80, 100}, {81, 99},  {82, 98},  {83, 97},  {84, 96},  {85, 95},
		  {86, 94},  {87, 93},  {88, 92},  {89, 91},  {90, 90},  {91, 89},  {92, 88},
		  {93, 87},  {94, 86},  {95, 85},  {96, 84},  {97, 83},  {98, 82},  {99, 81},
		  {100, 80}, {101, 79}, {102, 78}, {103, 77}, {104, 76}, {105, 75}, {106, 74},
		  {107, 73}, {108, 72}, {109, 71}, {110, 70}, {111, 69}, {112, 68}, {113, 67},
		  {114, 66}, {115, 65}, {116, 64}, {117, 63}, {118, 62}, {119, 61}, {120, 60},
		  {121, 59}, {122, 58}, {123, 57}, {124, 56}, {125, 55}, {126, 54}, {127, 53},
		  {128, 52}, {129, 51}, {130, 50}, {131, 49}, {132, 48}, {133, 47}, {134, 46},
		  {135, 45}, {136, 44}, {137, 43}, {138, 42}, {139, 41}, {140, 40}, {141, 39},
		  {142, 38}, {143, 37}, {144, 36}, {145, 35}, {146, 34}, {147, 33}, {148, 32},
		  {149, 31}, {150, 30}, {149, 31}, {148, 32}, {147, 33}, {146, 34}, {145, 35},
		  {144, 36}, {143, 37}, {142, 38}, {141, 39}, {140, 40}, {139, 41}, {138, 42},
		  {137, 43}, {136, 44}, {135, 45}, {134, 46}, {133, 47}, {132, 48}, {131, 49},
		  {130, 50}, {129, 51}, {128, 52}, {127, 53}, {126, 54}, {125, 55}, {124, 56},
		  {123, 57}, {122, 58}, {121, 59}, {120, 60}, {119, 61}, {118, 62}, {117, 63},
		  {116, 64}, {115, 65}, {114, 66}, {113, 67}, {112, 68}, {111, 69}, {110, 70},
		  {109, 71}, {108, 72}, {107, 73}, {106, 74}, {105, 75}, {104, 76}, {103, 77},
		  {102, 78}, {101, 79}, {100, 80}, {99, 81},  {98, 82},  {97, 83},  {96, 84},
		  {95, 85},  {94, 86},  {93, 87},  {92, 88},  {91, 89},  {90, 90},  {89, 91},
		  {88, 92},  {87, 93},  {86, 94},  {85, 95},  {84, 96},  {83, 97},  {82, 98},
		  {81, 99},  {80, 100}, {79, 101}, {78, 102}, {77, 103}, {76, 104}, {75, 105},
		  {74, 106}, {73, 107}, {72, 108}, {71, 109}, {70, 110}, {69, 111}, {68, 112},
		  {67, 113}, {66, 114}, {65, 115}, {64, 116}, {63, 117}, {62, 118}, {61, 119},
		  {60, 120}, {59, 121}, {58, 122}, {57, 123}, {56, 124}, {55, 125}, {54, 126},
		  {53, 127}, {52, 128}, {51, 129}, {50, 130}, {49, 131}, {48, 132}, {47, 133},
		  {46, 134}, {45, 135}, {44, 136}, {43, 137}, {42, 138}, {41, 139}, {40, 140},
		  {39, 141}, {38, 142}, {37, 143}, {36, 144}, {35, 145}, {34, 146}, {33, 147},
		  {32, 148}, {31, 149}, {30, 150}}};

static const struct rectangle obstacles[] = {
	/* Rectangle off to the left of arm */
	{.bottom = {.x1 = 60, .y1 = 90, .x2 = 74, .y2 = 90},
	 .top = {.x1 = 60, .y1 = 104, .x2 = 74, .y2 = 104},
	 .left = {.x1 = 60, .y1 = 90, .x2 = 60, .y2 = 104},
	 .right = {.x1 = 74, .y1 = 90, .x2 = 74, .y2 = 104}},

	/* Rectangle directly above arm and middle */
	{.bottom = {.x1 = 200, .y1 = 200, .x2 = 225, .y2 = 200},
	 .top = {.x1 = 200, .y1 = 260, .x2 = 225, .y2 = 260},
	 .left = {.x1 = 200, .y1 = 200, .x2 = 200, .y2 = 260},
	 .right = {.x1 = 225, .y1 = 200, .x2 = 225, .y2 = 260}},

	{.bottom = {.x1 = 230, .y1 = 170, .x2 = 260, .y2 = 170},
	 .top = {.x1 = 230, .y1 = 195, .x2 = 260, .y2 = 195},
	 .left = {.x1 = 230, .y1 = 170, .x2 = 230, .y2 = 195},
	 .right = {.x1 = 260, .y1 = 170, .x2 = 260, .y2 = 195}},
};
```

## src/obstacles.h
```c
/*
 * SPDX-License-Identifier: Apache-2.0
 */

#ifndef APP_OBSTACLES_H_
#define APP_OBSTACLES_H_

#include <lib/map_utils.h>

struct rectangle obstacles[] = {

	/* Rectangle off to the left of arm */
	{.bottom = {.x1 = 60, .y1 = 90, .x2 = 74, .y2 = 90},
	.top = {.x1 = 60, .y1 = 104, .x2 = 74, .y2 = 104},
	.left = {.x1 = 60, .y1 = 90, .x2 = 60, .y2 = 104},
	.right = {.x1 = 74, .y1 = 90, .x2 = 74, .y2 = 104}},

	/* Rectangle directly above arm and middle */
	{.bottom = {.x1 = 200, .y1 = 200, .x2 = 225, .y2 = 200},
	.top = {.x1 = 200, .y1 = 260, .x2 = 225, .y2 = 260},
	.left = {.x1 = 200, .y1 = 200, .x2 = 200, .y2 = 260},
	.right = {.x1 = 225, .y1 = 200, .x2 = 225, .y2 = 260}},

	/* Rectangle right very close to base */
	// {.bottom = {.x1 = 200, .y1 = 50, .x2 = 225, .y2 = 50},
	// .top = {.x1 = 200, .y1 = 70, .x2 = 225, .y2 = 70},
	// .left = {.x1 = 200, .y1 = 50, .x2 = 200, .y2 = 70},
	// .right = {.x1 = 225, .y1 = 50, .x2 = 225, .y2 = 70}},
};

#endif /* APP_PATHFINDING_H_ */
```

## src/utils.h
```c
/*
 * SPDX-License-Identifier: Apache-2.0
 */

#ifndef APP_OBSTACLES_H_
#define APP_OBSTACLES_H_

#include <stdio.h>
#include <spaces.h>
#include <lib/map_utils.h>

/**
 * @brief Marker in .txt file for CSPACE
 */
#define CSPACE_MARKER "===CSPACE==="

/**
 * @brief Marker in .txt file for WSPACE
 */
#define WSPACE_MARKER "===WSPACE==="

/**
 * @brief Marker in .txt file marking done
 */
#define SPACE_MARKER "===DONE==="

/**
 * @brief Print wspace and cspace to console with delimiters
 */
static void print_spaces() __attribute__((unused));

static void print_cspace(uint8_t (*cspace)[CSPACE_DIMENSION])
{
	/* Print cspace marker */
	printf("%s\n", CSPACE_MARKER);

	for (int i = 0; i < CSPACE_DIMENSION; i++) {
		for (int j = 0; j < CSPACE_DIMENSION; j++) {
			printf("%d", cspace[i][j]);
		}
		printf("\n");
	}

	/* Printf close cspace drawing */
	printf("%s\n", CSPACE_MARKER);
}

static void print_wspace(uint8_t (*wspace)[WORKSPACE_DIMENSION])
{
	/* Print wspace marker */
	printf("%s\n", WSPACE_MARKER);

	for (int i = 0; i < WORKSPACE_DIMENSION; i++) {
		for (int j = 0; j < WORKSPACE_DIMENSION; j++) {
			printf("%d", wspace[i][j]);
		}
		printf("\n");
	}

	/* Printf close wspace drawing */
	printf("%s\n", WSPACE_MARKER);
}

void print_spaces(uint8_t (*cspace)[CSPACE_DIMENSION], uint8_t (*wspace)[WORKSPACE_DIMENSION])
{
	print_cspace(cspace);
	print_wspace(wspace);

	/* Print done message */
	printf("%s\n", SPACE_MARKER);
}

struct rectangle obstacles[] = {

	/* Rectangle off to the left of arm */
	{.bottom = {.x1 = 60, .y1 = 90, .x2 = 74, .y2 = 90},
	.top = {.x1 = 60, .y1 = 104, .x2 = 74, .y2 = 104},
	.left = {.x1 = 60, .y1 = 90, .x2 = 60, .y2 = 104},
	.right = {.x1 = 74, .y1 = 90, .x2 = 74, .y2 = 104}},

	/* Rectangle directly above arm and middle */
	{.bottom = {.x1 = 200, .y1 = 200, .x2 = 225, .y2 = 200},
	.top = {.x1 = 200, .y1 = 260, .x2 = 225, .y2 = 260},
	.left = {.x1 = 200, .y1 = 200, .x2 = 200, .y2 = 260},
	.right = {.x1 = 225, .y1 = 200, .x2 = 225, .y2 = 260}},

	/* Rectangle right very close to base */
	// {.bottom = {.x1 = 200, .y1 = 50, .x2 = 225, .y2 = 50},
	// .top = {.x1 = 200, .y1 = 70, .x2 = 225, .y2 = 70},
	// .left = {.x1 = 200, .y1 = 50, .x2 = 200, .y2 = 70},
	// .right = {.x1 = 225, .y1 = 50, .x2 = 225, .y2 = 70}},
};

#endif /* APP_PATHFINDING_H_ */
```
